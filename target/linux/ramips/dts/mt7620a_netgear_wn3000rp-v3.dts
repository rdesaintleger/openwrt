/* This file is released into the public domain */

#include "mt7620a_netgear_wn3x00rp.dtsi"

#include <dt-bindings/gpio/gpio.h>
#include <dt-bindings/input/input.h>

/ {
	compatible = "netgear,wn3000rp-v3", "ralink,mt7620a-soc";
	model = "Netgear WN3000RP v3";
};
